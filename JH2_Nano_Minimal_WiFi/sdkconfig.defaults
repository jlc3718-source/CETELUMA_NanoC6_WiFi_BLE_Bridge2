## JH2_Nano_Minimal_WiFi/sdkconfig.defaults
```kconfig
CONFIG_IDF_TARGET="esp32c6"
CONFIG_PARTITION_TABLE_CUSTOM=y
CONFIG_PARTITION_TABLE_CUSTOM_FILENAME="partitions.csv"
CONFIG_PARTITION_TABLE_OFFSET=0x8000
CONFIG_ESPTOOLPY_FLASHMODE_DIO=y
CONFIG_ESPTOOLPY_FLASHSIZE_4MB=y
CONFIG_BOOTLOADER_APP_ROLLBACK_ENABLE=y
CONFIG_LOG_DEFAULT_LEVEL_WARN=y
```

## JasonHome2NanoC6_Basic200/sdkconfig.defaults
```kconfig
CONFIG_IDF_TARGET="esp32c6"
CONFIG_PARTITION_TABLE_CUSTOM=y
CONFIG_PARTITION_TABLE_CUSTOM_FILENAME="partitions.csv"
CONFIG_PARTITION_TABLE_OFFSET=0x8000
CONFIG_ESPTOOLPY_FLASHSIZE_4MB=y
CONFIG_ESPTOOLPY_FLASHMODE_DIO=y
CONFIG_BOOTLOADER_APP_ROLLBACK_ENABLE=y
CONFIG_ESP_WIFI_SOFTAP_SUPPORT=y
CONFIG_ESP_WIFI_STA_DISCONNECTED_PM_ENABLE=n
CONFIG_HTTPD_MAX_REQ_HDR_LEN=1024
```

## JasonHome2NanoC6_IDF/main/Kconfig.projbuild
```kconfig
menu "Jason Home 2 native runtime"
    config JH2_NATIVE_ENABLE_ORACLE
        bool "Enable native outbound Oracle bridge (requires acceptance testing)"
        default n
        help
            Do not enable on production until 88 SmartDawn catalog
            entries, signed OTA, command ACK and image streaming have
            been validated on physical ESP32-C6 hardware.
    config JH2_NATIVE_READONLY_ACCEPTANCE
        bool "Restrict native Oracle commands to inventory diagnostics"
        default y
        help
            Preserve factory curtain data during physical acceptance.
            Allow only BLE catalog/status/connect and read-only rawWrite
            205/167/2904. Reject display writes, asset playback and OTA.
            Disabling this gate requires a separate verified production build.
    config JH2_NATIVE_BROWSER_OTA_COMPAT
        bool "Embed original Jason Home 2 browser OTA identity and sizing"
        default n
        help
            Compatibility for the existing factory browser's local
            runtime upload. No remote signing key is used. Build-only
            until acceptance on physical hardware.
endmenu
```

## NanoC6_BasicWifi/sdkconfig.defaults
```kconfig
CONFIG_PARTITION_TABLE_CUSTOM=y
CONFIG_PARTITION_TABLE_CUSTOM_FILENAME="partitions.csv"
CONFIG_PARTITION_TABLE_OFFSET=0x8000
CONFIG_ESPTOOLPY_FLASHSIZE_4MB=y
CONFIG_ESPTOOLPY_FLASHMODE_DIO=y
CONFIG_BOOTLOADER_APP_ROLLBACK_ENABLE=y
CONFIG_ESP_WIFI_SOFTAP_SUPPORT=y
```

## firmware/sdkconfig.defaults
```kconfig
CONFIG_IDF_TARGET="esp32c6"
CONFIG_ESPTOOLPY_FLASHSIZE_4MB=y
CONFIG_ESPTOOLPY_FLASHSIZE="4MB"
CONFIG_APP_PROJECT_VER_FROM_CONFIG=y
CONFIG_APP_PROJECT_VER="4.0.6"
CONFIG_BT_ENABLED=y
CONFIG_BT_NIMBLE_ENABLED=y
CONFIG_BT_NIMBLE_ROLE_CENTRAL=y
CONFIG_BT_NIMBLE_MAX_CONNECTIONS=3
CONFIG_BT_NIMBLE_MAX_BONDS=3
CONFIG_ESP_WIFI_SOFTAP_SUPPORT=y
CONFIG_MBEDTLS_CERTIFICATE_BUNDLE=y
# CONFIG_MBEDTLS_CERTIFICATE_BUNDLE_DEFAULT_FULL is not set
CONFIG_MBEDTLS_CERTIFICATE_BUNDLE_DEFAULT_CMN=y
CONFIG_ESP_TLS_INSECURE=y
CONFIG_ESP_TLS_SKIP_SERVER_CERT_VERIFY=y
CONFIG_SPIFFS_MAX_PARTITIONS=1
CONFIG_SPIFFS_USE_MAGIC=y
CONFIG_SPIFFS_USE_MAGIC_LENGTH=y
CONFIG_LWIP_MAX_SOCKETS=16
CONFIG_HTTPD_MAX_REQ_HDR_LEN=2048
CONFIG_HTTPD_MAX_URI_LEN=256
CONFIG_ESP_TASK_WDT_TIMEOUT_S=120

# Keep all ESP-IDF components optimized for the constrained dual-OTA layout.
CONFIG_COMPILER_OPTIMIZATION_SIZE=y
```

## minimal-recovery/sdkconfig.defaults
```kconfig
CONFIG_BOOTLOADER_APP_ROLLBACK_ENABLE=y
CONFIG_ESP_COREDUMP_ENABLE_TO_FLASH=y
CONFIG_ESP_COREDUMP_DATA_FORMAT_ELF=y
CONFIG_ESP_SYSTEM_PANIC_PRINT_REBOOT=y
CONFIG_ESP_TASK_WDT_EN=y
CONFIG_ESP_TASK_WDT_INIT=y
CONFIG_ESP_TASK_WDT_TIMEOUT_S=10
CONFIG_COMPILER_OPTIMIZATION_SIZE=y
```
